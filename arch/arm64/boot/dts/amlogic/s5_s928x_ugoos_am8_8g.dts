#include "s5_s928x_ugoos_am8_4g.dts"

/ {
	coreelec-dt-id = "s5_s928x_ugoos_am8_8g";
	amlogic-dt-id = "s5_s928x_AM8-8g";

	memory@00000000 {
		linux,usable-memory = <0x00000000 0x00000000 0x00000000 0xE0000000
					0x00000001 0x00000000 0x00000001 0x20000000>;
	};
};
