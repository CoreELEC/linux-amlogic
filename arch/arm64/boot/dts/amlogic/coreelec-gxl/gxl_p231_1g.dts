#include "../gxl_p231_1g.dts"
#include "coreelec_gxl.dtsi"

/{
	coreelec-dt-id = "gxl_p231_1g";

	reserved-memory {
		logo_reserved:linux,meson-fb {
			/delete-property/ alloc-ranges;
		};
	};

	meson-fb {
		mem_alloc = <1>;
		logo_addr = "0x3fc00000";
	};
};
