#include "sm1_s905x3_2g.dts"

/{
	coreelec-dt-id = "sm1_s905x3_2g_1gbit";
};

&ethmac {
	pinctrl-names = "external_eth_pins";
	pinctrl-0 = <&external_eth_pins>;
	internal_phy = <0>;
	auto_cali_idx = <1>;
	/delete-property/ cali_val;
	/delete-property/ mc_val;
};
