#include "g12a_s905x2_2g_1gbit.dts"

/{
	model = "Beelink";
	coreelec-dt-id = "g12a_s905x2_beelink_gt_mini_a_2g";
	amlogic-dt-id = "g12a_s905x2_2g";

	memory@00000000 {
		linux,usable-memory = <0x0 0x00100000 0x0 0x7ff00000>;
	};
};

&dwc2_a {
	controller-type = <0x3>;
};

&i2c0 {
	status = "okay";
};
