## Documentation/devicetree/bindings/amlogic/ledstate.txt
```
Amlogic Meson LED
============================

Required properties:
	-for sc2
		amlogic,state-led-aocpu
```

## Documentation/devicetree/bindings/amlogic/spi-meson.txt
```
Amlogic Meson SPI controller

* slave SPICC

Required properties:
 - compatible: should be "amlogic,slave-spicc"
 - reg: physical base address and length of the controller registers
 - interrupts: The interrupt specifier
 - clock-names: Must contain "core", "comp"
 - clocks: phandle of the input clock for the baud rate generator
 - pinctrl-names: Should contain only one value - "default"
 - cs-num: Should be 0~3
 - spi-mode: Refer to spi-summary.txt
 - vmem-bus-num: Should be 0~16

Optional properties:

Examples:
	sspicc1: sspi@15000 {
		compatible = "amlogic,slave-spicc";
		reg = <0x15000 0x44>;
		interrupts = <GIC_SPI 90 IRQ_TYPE_LEVEL_HIGH>;
		clocks = <&clkc CLKID_SPICC1>,
			 <&clkc CLKID_SPICC1_COMP>;
		clock-names = "core", "comp";
		pinctrl-names = "default";
		pinctrl-0 = <&spicc1_pins_dv &spicc1_pins_cs_dv>;
		cs-num = <0>;
		spi-mode = <0x0>;
		vmem-bus-num = <0>;
	};
```

## Documentation/devicetree/bindings/input/touchscreen/sx8650.txt
```
* Semtech SX8650 I2C Touchscreen Controller

Required properties:
- compatible: must be "semtech,sx8650"
- reg: i2c slave address
- interrupt-parent: the phandle for the interrupt controller
- interrupts: touch controller interrupt

Example:

	sx8650@48 {
		compatible = "semtech,sx8650";
		reg = <0x48>;
		interrupt-parent = <&gpio6>;
		interrupts = <3 IRQ_TYPE_EDGE_FALLING>;
	};
```

## drivers/amlogic/dvb-avl/Kconfig
```kconfig
#
# AVL6862 dvb driver configuration
#

menu "AVL6862 dvb driver"

config AVL6862
	tristate "AVL6862 dvb driver"
	default n
	select DVB_CORE
	help
		Select to enable AVL6862 dvb driver.
endmenu
```

## drivers/amlogic/dvb/Kconfig
```kconfig
menu "AMLOGIC DVB COMPAT support"

config AMLOGIC_DVB_COMPAT
	bool "Amlogic DVB drivers"
	default N
	help
		select it to support amlogic dvb driver.
		Y: enable
		N: disable
		M: build as module
endmenu
```

## drivers/amlogic/led/Kconfig
```kconfig
#
# LED drivers configuration
#

menuconfig AMLOGIC_LED
	bool "Amlogic LED Support"
	default n
	help
	  Say Y here to get to see options for led drivers.
	  This option alone does not add any kernel code.

	  If you say N, all options in this submenu will be
	  skipped and disabled.


if AMLOGIC_LED

config AMLOGIC_LED_SYS
	bool "System LED Support"
	depends on LEDS_CLASS
	default n
	help
	  This option enables support for system led drivers.

	  Enable this option to allow the userspace to control
	  the system led.

config AMLOGIC_LEDS_TLC59116
	tristate "LED Support for the TLC59116"
	depends on LEDS_CLASS
	default n
	help
	  Choose this option if you want to use the LED on
	  TLC59116.

config AMLOGIC_LEDS_STATE
	tristate "LED state support"
	depends on LEDS_CLASS
	default n
	help
	  Choose this option if you want to use the LED state.
endif
```

## drivers/amlogic/media/common/lut_dma/Kconfig
```kconfig
#
# LUT DMA management driver configuration
#

menu "LUT DMA management driver"

config AMLOGIC_MEDIA_LUT_DMA
	bool "Amlogic LUT DMA management driver"
	default n
	help
		Select to enable LUT DMA management driver.
endmenu
```

## drivers/amlogic/media/common/vpu_security/Kconfig
```kconfig
#
# VPU SECURITY driver configuration
#

menu "VPU SECURITY driver"

config AMLOGIC_MEDIA_SECURITY
	bool "Amlogic VPU SECURITY driver"
	default n
	help
		Select to enable VPU SECURITY driver.
endmenu
```

## drivers/amlogic/media/di_multi_v3/Kconfig
```kconfig
#
# Deinterlace driver configuration
#

menu "DI_MULTI_V3 driver"

config AMLOGIC_MEDIA_DEINTERLACE
	tristate "DI_MULTI_V3 driver"
	default n
	help
		Select to enable AMLOGIC DEINTERLACE driver
		process interlace source need three continueed fields,
		wave progressive source with two interlace fields from
		one progreesive fields
endmenu
```

## drivers/amlogic/media/vout/backlight/aml_ldim/Kconfig
```kconfig
#
# LDIM Device Driver Configuration
#
config AMLOGIC_LOCAL_DIMMING
	bool "Amlogic Local Dimming"
	default n
	help
		Say Y if you want to use Amlogic Local dimming.
		The role of local dimming is according to each
		image information, calculate the corresponding
		brightness values, to improve the effect of image quality

config CONFIG_AML_LOCAL_DIMMING_IW7038
	bool "Amlogic local Diming Iw7038"
	depends on AMLOGIC_LOCAL_DIMMING
	default n
	help
		Spi iw7038 controller support.
		Once use the local dimming, add the spi driver
		Through the spi iw7038 to write data like brightness
		values for the local dimming

config CONFIG_AML_LOCAL_DIMMING_IW7027
        bool "Amlogic local Diming Iw7027"
        depends on AMLOGIC_LOCAL_DIMMING
        default n
        help
                Spi iw7029 controller support.
		Once use the local dimming, add the spi driver
                Through the spi iw7029 to write data like brightness
                values for the local dimming
```

## drivers/amlogic/media/vout/peripheral_lcd/Kconfig
```kconfig
menu "Amlogic Peripheral_lcd Support"

config AMLOGIC_PERIPHERAL_LCD
	bool "Amlogic peripheral_lcd support"
	depends on BACKLIGHT_CLASS_DEVICE
	default n
	help
		Say Y here if you want to use the Amlogic peripheral_lcd management.
		Peripheral_lcd include spi_lcd and other peripheral_lcd that you want
		to add.

endmenu
```

## drivers/amlogic/pwm/Kconfig
```kconfig
#
# PWM configuration
#


menuconfig AMLOGIC_PWM
	bool "Amlogic PWM driver"
	depends on PWM_SYSFS
	depends on PWM
	default n
	help
	  say y to enable Amlogic PWM driver.


if AMLOGIC_PWM
config  AMLOGIC_PWM_V2
        bool "Meson Soc pwm v2 driver"
        help
          The platform driver for Amlogic Meson PWM controller.
          This PWM controller transfers the clk div, clk gate,
          and clk mux to the clktree.
        default n

endif
```

## drivers/amlogic/reset/Kconfig
```kconfig
config AMLOGIC_RESET_MESON
	tristate "Amlogic Reset Driver"
	depends on RESET_CONTROLLER
	default y if ARCH_HAS_RESET_CONTROLLER
	help
	  This enables the reset driver for Amlogic Meson SoCs.
```

## drivers/amlogic/wetek/Kconfig
```kconfig
#
# Wetek Play driver configuration
#

menu "WeTek Play driver"

config WETEK
	tristate "Wetek Play driver"
	default n
	select DVB_CORE
	help
		Select to enable Wetek Play driver.
endmenu
```

## drivers/android/binder/Kconfig
```kconfig
# SPDX-License-Identifier: GPL-2.0

config ANDROID_BINDER_IPC_RUST
	tristate "Rust version of Android Binder IPC Driver"
	depends on RUST && MMU
	help
	  This enables the Rust implementation of the Binder driver. At this
	  time, the Rust implementation can only be built as an alternative to
	  the C implementation. By default, the C implementation is used, but
	  if the binder.impl=rust kernel command-line parameter is provided,
	  then the Rust implementation is used instead.

	  To build this as a GKI module, choose m.
```

## drivers/bootloader/Kconfig
```kconfig
#
# For a description of the syntax of this configuration file,
# see Documentation/kbuild/kconfig-language.txt.
#

menu "Bootloader Drivers"

config BL301_MANAGER
       tristate "Team CoreELEC bl301 helper driver"
       ---help---
          Driver to parse handle data between
          config.ini and bootloader blob bl301.

endmenu
```
